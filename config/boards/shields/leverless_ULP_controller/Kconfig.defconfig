## config/boards/shields/leverless_ULP_controller/Kconfig.defconfig
```kconfig
if SHIELD_LEVERLESS_ULP_CONTROLLER

    config ZMK_KEYBOARD_NAME
        default "Leverless ULP Controller"

endif
```

## config/boards/shields/leverless_ULP_controller/Kconfig.shield
```kconfig
config SHIELD_LEVERLESS_ULP_CONTROLLER
    def_bool $(shields_list_contains,leverless_ULP_controller)
```
